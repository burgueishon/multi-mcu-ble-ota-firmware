## CMakeLists.txt
```
# SPDX-License-Identifier: Apache-2.0

cmake_minimum_required(VERSION 3.20.0)
find_package(Zephyr REQUIRED HINTS $ENV{ZEPHYR_BASE})
project(nrf52840_firmware)

target_include_directories(app PRIVATE ${CMAKE_CURRENT_SOURCE_DIR}/include)

target_sources(app PRIVATE
  src/main.c
  src/uart_comm.c
  src/ble_service.c
  src/ota_service.c
)
```

## sample.yaml
```
sample:
  name: UART + BLE OTA Firmware Example
tests:
  sample.uart_comm:
    tags:
      - uart
    platform_allow: xiao_ble
    harness: console
    integration_platforms:
      - xiao_ble
```

## prj.conf
```kconfig
# UART serial configuration
CONFIG_SERIAL=y
CONFIG_UART_INTERRUPT_DRIVEN=y

# Floating‑point print support
CONFIG_CBPRINTF_FP_SUPPORT=y
CONFIG_FP_HARDABI=y

# CRC support
CONFIG_CRC=y

# GPIO support
CONFIG_GPIO=y

# Logging over RTT
CONFIG_LOG=y
CONFIG_USE_SEGGER_RTT=y
CONFIG_LOG_BACKEND_RTT=y
CONFIG_LOG_MODE_DEFERRED=y
CONFIG_LOG_DEFAULT_LEVEL=3

# Bluetooth Core
CONFIG_BT=y
CONFIG_BT_PERIPHERAL=y
CONFIG_BT_DEVICE_NAME="XiaoBLE"
CONFIG_BT_DEVICE_APPEARANCE=0

# Advertising settings
CONFIG_BT_EXT_ADV=y

# GATT settings
CONFIG_BT_GATT_SERVICE_CHANGED=y
```

## src/main.c
```c
#include <zephyr/kernel.h>
#include <zephyr/device.h>
#include <zephyr/drivers/gpio.h>
#include <zephyr/logging/log.h>

#include "uart_comm.h"
#include "ble_service.h"
#include "ota_service.h"

LOG_MODULE_REGISTER(main, LOG_LEVEL_INF);

// Device Tree alias for the LED pin
#define LED_NODE DT_ALIAS(led0)

// OTA processing thread configuration
#define OTA_THREAD_STACK_SIZE 1024
#define OTA_THREAD_PRIORITY   5

static const struct gpio_dt_spec led = GPIO_DT_SPEC_GET(LED_NODE, gpios);

/**
 * @brief Thread to handle OTA processing.
 *
 * Runs at high priority and processes OTA frames when active.
 */
static void ota_thread(void *unused1, void *unused2, void *unused3)
{
    while (1) {
        if (ota_is_active()) {
            ota_process_loop();
            k_msleep(1);   // Responsive during OTA
        } else {
            k_msleep(50);  // Idle when no OTA
        }
    }
}

// Define and start the OTA thread
K_THREAD_DEFINE(ota_thread_id,
                OTA_THREAD_STACK_SIZE,
                ota_thread,
                NULL, NULL, NULL,
                OTA_THREAD_PRIORITY,
                0, 0);

/**
 * @brief Application entry point
 *
 * Initializes peripherals, services, and enters main loop.
 */
int main(void)
{
    bool led_on = false;
    const sensor_data_t *sensor = NULL;

    LOG_INF("Booting application");

    // Initialize LED GPIO
    if (!device_is_ready(led.port)) {
        LOG_ERR("LED device not ready");
        // Halt if LED is unavailable
        while (1) {
            k_msleep(1000);
        }
    }
    gpio_pin_configure_dt(&led, GPIO_OUTPUT_INACTIVE);

    // Initialize UART communication
    if (uart_comm_init() != 0) {
        LOG_ERR("UART initialization failed");
        // Halt on UART init failure
        while (1) {
            k_msleep(1000);
        }
    }

    // Initialize BLE and OTA services
    ble_service_init();
    ota_service_init();

    LOG_INF("Initialization complete");

    // Main loop: blink LED, read sensor, send data via BLE
    while (1) {
        // Toggle LED - board
        led_on = !led_on;
        gpio_pin_set_dt(&led, led_on);

        // Fetch latest sensor data
        sensor = uart_comm_get_sensor_data();
        if (sensor && sensor->valid) {
            LOG_INF("Sensor: %.2f°C, %.2f%% RH",
                    (double)sensor->temperature,
                    (double)sensor->humidity);
            ble_service_send_sensor_data(sensor);
        }

        k_msleep(500);
    }
}
```

## include/ble_service.h
```c
#ifndef BLE_SERVICE_H
#define BLE_SERVICE_H

#ifdef __cplusplus
extern "C" {
#endif

#include "uart_comm.h" // For sensor_data_t
#include <zephyr/types.h>

/**
 * @brief Initialize the BLE service and characteristics.
 */
void ble_service_init(void);

/**
 * @brief Send sensor data via BLE notification.
 *
 * @param data Pointer to valid sensor data structure.
 */
void ble_service_send_sensor_data(const sensor_data_t *data);

#ifdef __cplusplus
}
#endif

#endif // BLE_SERVICE_H
```

## include/ota_service.h
```c
#ifndef OTA_SERVICE_H
#define OTA_SERVICE_H

#include <zephyr/bluetooth/uuid.h>

#ifdef __cplusplus
extern "C" {
#endif

// Global OTA state
extern bool ota_active;
extern enum ota_phase_t ota_phase;

// OTA transmission phases
enum ota_phase_t {
    OTA_PHASE_IDLE = 0,             // Not doing OTA
    OTA_PHASE_WAIT_ALL_CHUNKS,     // Waiting for all BLE chunks (INIT received)
    OTA_PHASE_WAIT_ACK_INIT,       // INIT sent, waiting for ACK
    OTA_PHASE_SENDING_DATA,        // Sending data chunks to target
    OTA_PHASE_WAIT_ACK_END,        // END sent, waiting for CRC and ACK
    OTA_PHASE_DONE,                // OTA completed
    OTA_PHASE_ABORTED,             // OTA failed or was aborted
};

// BLE command markers used to indicate OTA start/end
#define BLE_CMD_INIT 0x10
#define BLE_CMD_END  0x11

// Called when a BLE chunk is received (from BLE write callback)
void ota_queue_push(const uint8_t *data, uint16_t len);

// Initializes OTA BLE service and work queue
void ota_service_init(void);

// Main loop processor (usually called from main loop or k_work)
void ota_process_loop(void);

// Returns true if OTA is currently active
bool ota_is_active(void);

// Handle ACK received from target device
void ota_service_handle_ack(uint8_t *payload, uint8_t length);

// Get current OTA phase
enum ota_phase_t ota_get_phase(void);

#ifdef __cplusplus
}
#endif

#endif // OTA_SERVICE_H
```

## include/uart_comm.h
```c
#ifndef UART_COMM_H
#define UART_COMM_H

#include <stdbool.h>
#include <stdint.h>
#include <zephyr/device.h>
#include <zephyr/kernel.h>

//
// UART packet types and OTA command codes
//

#define PREAMBLE 0xAA // Start byte for UART packets

// UART packet types
#define UART_PKT_SENSOR 0x01 // Sensor data packet
#define UART_PKT_CMD 0x02    // Command packet
#define UART_PKT_ACK 0x03    // Acknowledgment packet

// OTA command types
#define OTA_CMD_INIT 0x00   // Begin OTA
#define OTA_CMD_DATA 0x01   // OTA data chunk
#define OTA_CMD_END 0x02    // End OTA
#define OTA_CMD_REBOOT 0x03 // Reboot device

// Power management commands
#define UART_CMD_SLEEP 0x10 // Put MCU to sleep
#define UART_CMD_WAKE 0x11  // Wake MCU (no-op on target)

#define UART_MAX_PAYLOAD_SIZE 64 // Max bytes in UART payload

//
// UART packet structure
//
typedef struct {
  uint8_t preamble;                       // Should always be 0xAA
  uint8_t type;                           // Packet type
  uint8_t length;                         // Payload length
  uint8_t payload[UART_MAX_PAYLOAD_SIZE]; // Payload data
  uint8_t crc; // CRC8 of entire packet (excluding this byte)
} __packed uart_packet_t;

//
// Sensor data structure
//
typedef struct {
  float temperature; // Temperature in °C
  float humidity;    // Relative humidity in %
  bool valid;        // Flag indicating if values are valid
} sensor_data_t;

//
// UART communication API
//
int uart_comm_init(void);
const sensor_data_t *uart_comm_get_sensor_data(void);
const struct device *uart_comm_get_dev(void);
int uart_comm_send_cmd(uint8_t pkt_type, uint8_t cmd, const uint8_t *payload,
                       uint8_t length);
bool uart_comm_is_tx_busy(void);

#endif // UART_COMM_H
```

## src/ble_service.c
```c
#include "ble_service.h"
#include <string.h>
#include <zephyr/bluetooth/bluetooth.h>
#include <zephyr/bluetooth/gatt.h>
#include <zephyr/logging/log.h>

LOG_MODULE_REGISTER(ble_service, LOG_LEVEL_INF);

static struct bt_conn *current_conn = NULL;

// 128-bit UUIDs for the service and characteristic
static struct bt_uuid_128 service_uuid =
    BT_UUID_INIT_128(0x12, 0x34, 0x56, 0x78, 0x9a, 0xbc, 0xde, 0xf0, 0x12, 0x34,
                     0x56, 0x78, 0x9a, 0xbc, 0xde, 0xf0);

static struct bt_uuid_128 sensor_char_uuid =
    BT_UUID_INIT_128(0xab, 0xcd, 0xef, 0x01, 0x23, 0x45, 0x67, 0x89, 0xab, 0xcd,
                     0xef, 0x01, 0x23, 0x45, 0x67, 0x89);

static uint8_t sensor_value[8];

// Handle read requests from clients
static ssize_t read_sensor(struct bt_conn *conn,
                           const struct bt_gatt_attr *attr, void *buf,
                           uint16_t len, uint16_t offset) {
  return bt_gatt_attr_read(conn, attr, buf, len, offset, sensor_value,
                           sizeof(sensor_value));
}

// Called when notifications are enabled/disabled
static void sensor_ccc_cfg_changed(const struct bt_gatt_attr *attr,
                                   uint16_t value) {
  bool notify_enabled = (value == BT_GATT_CCC_NOTIFY);
  LOG_INF("Notifications %s", notify_enabled ? "enabled" : "disabled");
}

// GATT service definition
BT_GATT_SERVICE_DEFINE(sensor_svc, BT_GATT_PRIMARY_SERVICE(&service_uuid),
                       BT_GATT_CHARACTERISTIC(&sensor_char_uuid.uuid,
                                              BT_GATT_CHRC_READ |
                                                  BT_GATT_CHRC_NOTIFY,
                                              BT_GATT_PERM_READ, read_sensor,
                                              NULL, sensor_value),
                       BT_GATT_CCC(sensor_ccc_cfg_changed,
                                   BT_GATT_PERM_READ | BT_GATT_PERM_WRITE), );

// Connection callbacks
static void connected(struct bt_conn *conn, uint8_t err) {
  if (err == 0) {
    current_conn = bt_conn_ref(conn);
    LOG_INF("BLE client connected");
  } else {
    LOG_WRN("Connection failed (err %u)", err);
  }
}

static void disconnected(struct bt_conn *conn, uint8_t reason) {
  LOG_INF("BLE client disconnected (reason %u)", reason);
  if (current_conn) {
    bt_conn_unref(current_conn);
    current_conn = NULL;
  }
}

static struct bt_conn_cb conn_callbacks = {
    .connected = connected,
    .disconnected = disconnected,
};

void ble_service_init(void) {
  int err;

  err = bt_set_name("XiaoBLE");
  if (err) {
    LOG_ERR("Failed to set BLE name (err %d)", err);
  }

  err = bt_enable(NULL);
  if (err) {
    LOG_ERR("Bluetooth init failed (err %d)", err);
    return;
  }

  bt_conn_cb_register(&conn_callbacks);
  LOG_INF("Bluetooth initialized as XiaoBLE");

  static const uint8_t flags = BT_LE_AD_GENERAL | BT_LE_AD_NO_BREDR;
  static const uint8_t svc_uuid[] = {0xf0, 0xde, 0xbc, 0x9a, 0x78, 0x56,
                                     0x34, 0x12, 0xf0, 0xde, 0xbc, 0x9a,
                                     0x78, 0x56, 0x34, 0x12};

  static const struct bt_data ad[] = {
      {.type = BT_DATA_FLAGS, .data_len = sizeof(flags), .data = &flags},
      {.type = BT_DATA_UUID128_ALL,
       .data_len = sizeof(svc_uuid),
       .data = svc_uuid}};

// Suppress warnings for deprecated API usage (still needed for BLE advertising in Zephyr 4.1+)
#pragma GCC diagnostic push
#pragma GCC diagnostic ignored "-Wdeprecated-declarations"
// BLE advertising parameters (extended advertising not used here)
  static const struct bt_le_adv_param adv_params = {
      .id = BT_ID_DEFAULT,
      .sid = 0,
      .secondary_max_skip = 0,
      .options = BT_LE_ADV_OPT_USE_NAME | BT_LE_ADV_OPT_CONNECTABLE,
      .interval_min = BT_GAP_ADV_FAST_INT_MIN_2,
      .interval_max = BT_GAP_ADV_FAST_INT_MAX_2,
      .peer = NULL,
  };
#pragma GCC diagnostic pop

  err = bt_le_adv_start(&adv_params, ad, ARRAY_SIZE(ad), NULL, 0);
  if (err) {
    LOG_ERR("Advertising failed to start (err %d)", err);
  } else {
    LOG_INF("Advertising started with name and service UUID");
  }
}

void ble_service_send_sensor_data(const sensor_data_t *data) {
  memcpy(&sensor_value[0], &data->temperature, sizeof(float));
  memcpy(&sensor_value[4], &data->humidity, sizeof(float));

  if (current_conn && bt_gatt_is_subscribed(current_conn, &sensor_svc.attrs[1],
                                            BT_GATT_CCC_NOTIFY)) {
    bt_gatt_notify(current_conn, &sensor_svc.attrs[1], sensor_value,
                   sizeof(sensor_value));
    LOG_INF("Sensor data notified: Temp=%.2f C, Hum=%.2f %%",
            (double)data->temperature, (double)data->humidity);
  } else {
    LOG_DBG("No client subscribed. Notification skipped.");
  }
}
```

## src/ota_service.c
```c
// OTA service implementation for BLE-triggered firmware updates

#include "ota_service.h"
#include "uart_comm.h"
#include <string.h>
#include <zephyr/bluetooth/bluetooth.h>
#include <zephyr/bluetooth/gatt.h>
#include <zephyr/drivers/uart.h>
#include <zephyr/kernel.h>
#include <zephyr/logging/log.h>
#include <zephyr/sys/printk.h>

LOG_MODULE_REGISTER(ota_service, LOG_LEVEL_DBG);

// Constants
#define OTA_MAX_CHUNK_SIZE 20 // Max BLE write chunk size
#define OTA_QUEUE_SIZE 3000   // Max number of OTA BLE chunks stored

// OTA state
static bool ack_received = false;
static bool ota_init_sent = false;
bool ota_active = false;
enum ota_phase_t ota_phase = OTA_PHASE_IDLE;

static uint8_t ota_retry_count = 0;
#define OTA_MAX_RETRIES 3
#define OTA_ACK_TIMEOUT_MS 4000 // Retry delay

static uint32_t ota_chunk_index = 0;
static uint32_t ble_chunk_counter = 0;
static uint8_t last_chunk[OTA_MAX_CHUNK_SIZE];
static uint16_t last_len;

// BLE UUIDs for OTA service
static struct bt_uuid_128 ota_service_uuid =
    BT_UUID_INIT_128(0x11, 0x11, 0x11, 0x11, 0x22, 0x22, 0x33, 0x33, 0x44, 0x44,
                     0x55, 0x55, 0x55, 0x55, 0x55, 0x55);

static struct bt_uuid_128 ota_data_char_uuid =
    BT_UUID_INIT_128(0x66, 0x66, 0x66, 0x66, 0x77, 0x77, 0x88, 0x88, 0x99, 0x99,
                     0xaa, 0xaa, 0xaa, 0xaa, 0xaa, 0xaa);

// BLE work structure
static struct k_work ota_send_work;

// BLE chunk queue
struct ota_chunk {
  uint8_t data[OTA_MAX_CHUNK_SIZE];
  uint16_t len;
};

static struct ota_chunk ota_queue[OTA_QUEUE_SIZE];
static volatile int ota_queue_head = 0;
static volatile int ota_queue_tail = 0;

/* Forward declarations */
static void ota_send_work_fn(struct k_work *work);
static const char *ota_phase_str(enum ota_phase_t phase);

/* Retry timer handler */
static void ota_retry_handler(struct k_timer *timer) {
  if (ota_phase == OTA_PHASE_WAIT_ACK_INIT) {
    ota_retry_count++;
    if (ota_retry_count > OTA_MAX_RETRIES) {
      ota_phase = OTA_PHASE_ABORTED;
      ota_active = false;
      LOG_ERR("OTA aborted. No ACK for INIT");
    } else {
      LOG_WRN("Retrying OTA_CMD_INIT (%d/%d)", ota_retry_count,
              OTA_MAX_RETRIES);
      int ret = uart_comm_send_cmd(UART_PKT_CMD, OTA_CMD_INIT, NULL, 0);
      if (ret == 0) {
        LOG_INF("Resent OTA_CMD_INIT");
      } else {
        LOG_ERR("Failed to resend INIT: %d", ret);
      }
    }
  } else if (ota_phase == OTA_PHASE_SENDING_DATA) {
    ota_retry_count++;
    if (ota_retry_count > OTA_MAX_RETRIES) {
      ota_phase = OTA_PHASE_ABORTED;
      ota_active = false;
      LOG_ERR("OTA aborted. No ACK for DATA");
    } else {
      LOG_WRN("Retrying OTA_CMD_DATA (%d/%d)", ota_retry_count,
              OTA_MAX_RETRIES);
      ack_received = true; // allow resend in process loop
      k_work_submit(&ota_send_work);
    }
  }
}

K_TIMER_DEFINE(ota_timer, ota_retry_handler, NULL);

/* Work item to continue OTA logic */
static void ota_send_work_fn(struct k_work *work) { ota_process_loop(); }

/* Clear all OTA state */
void ota_service_reset(void) {
  ota_active = false;
  ota_init_sent = false;
  ota_retry_count = 0;
  ota_chunk_index = 0;
  ble_chunk_counter = 0;  
  ota_phase = OTA_PHASE_IDLE;
  k_timer_stop(&ota_timer);
  LOG_INF("OTA reset complete");
}

/* OTA state accessors */
void ota_start(void) { ota_active = true; }
bool ota_is_active(void) { return ota_active; }
void ota_set_active(bool active) { ota_active = active; }
enum ota_phase_t ota_get_phase(void) { return ota_phase; }

static bool ota_queue_is_empty(void) {
  return ota_queue_head == ota_queue_tail;
}

/* Push received BLE chunk into circular queue */
void ota_queue_push(const uint8_t *data, uint16_t len) {
  if (len > OTA_MAX_CHUNK_SIZE) {
    LOG_ERR("Chunk too large: %d", len);
    return;
  }

  // Handle BLE commands directly
  uint8_t ble_cmd = data[0];
  switch (ble_cmd) {
  case BLE_CMD_INIT:
    if (ota_phase != OTA_PHASE_IDLE && ota_phase != OTA_PHASE_DONE) {
      LOG_WRN("BLE_CMD_INIT unexpected in phase %s", ota_phase_str(ota_phase));
      return;
    }
    LOG_INF("BLE_CMD_INIT received. Waiting for BLE chunks...");
    ota_set_active(true);
    ota_phase = OTA_PHASE_WAIT_ALL_CHUNKS;
    return;

  case BLE_CMD_END:
    if (ota_phase != OTA_PHASE_WAIT_ALL_CHUNKS) {
      LOG_WRN("BLE_CMD_END unexpected in phase %s", ota_phase_str(ota_phase));
      return;
    }
    LOG_INF("BLE_CMD_END received. OTA will begin");
    ota_phase = OTA_PHASE_IDLE;
    return;

  default:
    break;
  }

  // Push raw chunk data to queue
  int next_head = (ota_queue_head + 1) % OTA_QUEUE_SIZE;
  if (next_head == ota_queue_tail) {
    LOG_WRN("OTA queue full. Discarded chunk: %02X %02X %02X %02X", data[0],
            data[1], data[2], data[3]);
    return;
  }

    memcpy(ota_queue[ota_queue_head].data, data + 1, len - 1);
    ota_queue[ota_queue_head].len = len - 1;

    ble_chunk_counter++;
    LOG_DBG("Received BLE chunk #%u (%u bytes)", ble_chunk_counter, len - 1);

    ota_queue_head = next_head;

}

static bool ota_queue_pop(uint8_t *out_data, uint16_t *out_len) {
  if (ota_queue_is_empty()) {
    return false;
  }

  memcpy(out_data, ota_queue[ota_queue_tail].data,
         ota_queue[ota_queue_tail].len);
  *out_len = ota_queue[ota_queue_tail].len;
  ota_queue_tail = (ota_queue_tail + 1) % OTA_QUEUE_SIZE;
  return true;
}

/* BLE write callback */
static ssize_t ota_data_write_cb(struct bt_conn *conn,
                                 const struct bt_gatt_attr *attr,
                                 const void *buf, uint16_t len, uint16_t offset,
                                 uint8_t flags) {
  if (len > OTA_MAX_CHUNK_SIZE) {
    return BT_GATT_ERR(BT_ATT_ERR_INVALID_ATTRIBUTE_LEN);
  }

  ota_queue_push((const uint8_t *)buf, len);
  ota_init_sent = false;
  return len;
}

/* BLE OTA service declaration */
BT_GATT_SERVICE_DEFINE(ota_svc, BT_GATT_PRIMARY_SERVICE(&ota_service_uuid),
                       BT_GATT_CHARACTERISTIC(&ota_data_char_uuid.uuid,
                                              BT_GATT_CHRC_WRITE_WITHOUT_RESP,
                                              BT_GATT_PERM_WRITE, NULL,
                                              ota_data_write_cb, NULL));

/* Initialize OTA service and work item */
void ota_service_init(void) {
  k_work_init(&ota_send_work, ota_send_work_fn);
  LOG_INF("OTA BLE service initialized");
}

/* Debug print phase name */
static const char *ota_phase_str(enum ota_phase_t phase) {
  switch (phase) {
  case OTA_PHASE_IDLE:
    return "IDLE";
  case OTA_PHASE_WAIT_ALL_CHUNKS:
    return "WAIT_ALL_CHUNKS";
  case OTA_PHASE_WAIT_ACK_INIT:
    return "WAIT_ACK_INIT";
  case OTA_PHASE_SENDING_DATA:
    return "SENDING_DATA";
  case OTA_PHASE_WAIT_ACK_END:
    return "WAIT_ACK_END";
  case OTA_PHASE_DONE:
    return "DONE";
  case OTA_PHASE_ABORTED:
    return "ABORTED";
  default:
    return "UNKNOWN";
  }
}

/**
 * @brief Handles an ACK packet received via UART.
 *
 * Validates the ACK command and advances the OTA flow according to the current
 * phase.
 *
 * @param payload  Pointer to the ACK packet payload (must contain at least 1
 * byte)
 * @param length   Length of the received payload
 */
void ota_service_handle_ack(uint8_t *payload, uint8_t length) {
  if (length < 1) {
    LOG_WRN("ACK received with invalid length (%d)", length);
    return;
  }

  uint8_t ack_cmd = payload[0];
  LOG_INF("ACK received in ota_service_handle_ack: cmd=0x%02X", ack_cmd);

  switch (ota_phase) {

  case OTA_PHASE_WAIT_ACK_INIT:
    if (ack_cmd == OTA_CMD_INIT) {
      LOG_INF("ACK for OTA_CMD_INIT received. Starting data transmission...");
      ota_retry_count = 0;
      ota_phase = OTA_PHASE_SENDING_DATA;
      k_timer_stop(&ota_timer);
      ack_received = true;
      k_work_submit(&ota_send_work);
    } else {
      LOG_WRN("Expected ACK for INIT, but got cmd=0x%02X", ack_cmd);
    }
    break;

  case OTA_PHASE_SENDING_DATA:
    if (ack_cmd == OTA_CMD_DATA) {
      LOG_INF("ACK for OTA_CMD_DATA received");
      ack_received = true;
      ota_retry_count = 0;
      k_timer_stop(&ota_timer);
      k_work_submit(&ota_send_work);
    } else {
      LOG_WRN("Expected ACK for DATA, but got cmd=0x%02X", ack_cmd);
    }
    break;

  case OTA_PHASE_WAIT_ACK_END:
    if (ack_cmd == OTA_CMD_END) {
      LOG_INF("ACK for OTA_CMD_END received");

      if (length == 5) {
        uint32_t crc = ((uint32_t)payload[1] << 24) |
                       ((uint32_t)payload[2] << 16) |
                       ((uint32_t)payload[3] << 8) | ((uint32_t)payload[4]);

        LOG_INF("CRC32 received: 0x%08X", crc);
        // Optional: validate CRC here
      } else {
        LOG_WRN("ACK for END received with unexpected length (len=%d)", length);
      }

      int ret = uart_comm_send_cmd(UART_PKT_CMD, OTA_CMD_REBOOT, NULL, 0);
      if (ret == 0) {
        LOG_INF("Sent OTA_CMD_REBOOT to SAMD21");
      } else {
        LOG_ERR("Failed to send OTA_CMD_REBOOT: %d", ret);
      }

      k_sleep(K_MSEC(50));
      ota_service_reset();
      ota_phase = OTA_PHASE_DONE;
      ota_active = false;
      k_timer_stop(&ota_timer);
    } else {
      LOG_WRN("Expected ACK for END, but got cmd=0x%02X", ack_cmd);
    }
    break;

  default:
    LOG_WRN("Unexpected ACK in phase: %d (cmd=0x%02X)", ota_phase, ack_cmd);
    break;
  }
}
/**
 * @brief Processes the current state of the OTA flow.
 *
 * This function is called periodically (e.g., from a thread or work item)
 * to advance the OTA state machine, handling INIT, data transmission,
 * and END depending on the current phase.
 */
void ota_process_loop(void) {
  if (!ota_active) {
    return;
  }

  static enum ota_phase_t last_phase_logged = -1;
  if (ota_phase != last_phase_logged) {
    LOG_DBG("OTA process loop: current phase = %s", ota_phase_str(ota_phase));
    last_phase_logged = ota_phase;
  }

  switch (ota_phase) {

  case OTA_PHASE_IDLE:
    LOG_INF("Starting OTA: sending OTA_CMD_INIT");
    ota_retry_count = 0;
    ota_init_sent = true;
    ota_phase = OTA_PHASE_WAIT_ACK_INIT;

    if (uart_comm_send_cmd(UART_PKT_CMD, OTA_CMD_INIT, NULL, 0) == 0) {
      LOG_INF("OTA_CMD_INIT sent");
      k_timer_start(&ota_timer, K_MSEC(OTA_ACK_TIMEOUT_MS),
                    K_MSEC(OTA_ACK_TIMEOUT_MS));
    } else {
      LOG_ERR("Failed to send OTA_CMD_INIT");
      ota_phase = OTA_PHASE_ABORTED;
      ota_active = false;
    }
    break;

  case OTA_PHASE_SENDING_DATA: {
    if (!ack_received) {
      break;
    }

    if (ota_retry_count == 0) {
      if (!ota_queue_pop(last_chunk, &last_len)) {
        LOG_INF("All chunks sent. Sending OTA_CMD_END...");
        int ret = uart_comm_send_cmd(UART_PKT_CMD, OTA_CMD_END, NULL, 0);
        if (ret == 0) {
          LOG_INF("OTA_CMD_END sent. Waiting for CRC32...");
          ota_phase = OTA_PHASE_WAIT_ACK_END;
          ota_retry_count = 0;
          k_timer_start(&ota_timer, K_MSEC(OTA_ACK_TIMEOUT_MS), K_NO_WAIT);
        } else {
          LOG_ERR("Failed to send OTA_CMD_END: %d", ret);
          ota_phase = OTA_PHASE_ABORTED;
          ota_active = false;
        }
        break;
      }
      ota_chunk_index++;
      LOG_DBG("Sending chunk #%u", ota_chunk_index);
    }

    int ret =
        uart_comm_send_cmd(UART_PKT_CMD, OTA_CMD_DATA, last_chunk, last_len);
    if (ret == 0) {
      LOG_INF("OTA_CMD_DATA sent (%u bytes)", last_len);
      ack_received = false;
      ota_retry_count = 0;
      k_timer_start(&ota_timer, K_MSEC(OTA_ACK_TIMEOUT_MS), K_NO_WAIT);
    } else {
      LOG_ERR("Failed to send OTA_CMD_DATA: %d", ret);
      ota_phase = OTA_PHASE_ABORTED;
      ota_active = false;
    }
    break;
  }

  case OTA_PHASE_WAIT_ACK_INIT:
  case OTA_PHASE_WAIT_ACK_END:
  case OTA_PHASE_WAIT_ALL_CHUNKS:
  case OTA_PHASE_DONE:
  case OTA_PHASE_ABORTED:
    break;

  default:
    LOG_WRN("Unknown OTA phase: %d", ota_phase);
    break;
  }
}
```

## src/uart_comm.c
```c
#include "uart_comm.h"

#include <string.h>
#include <zephyr/drivers/uart.h>
#include <zephyr/logging/log.h>
#include <zephyr/sys/crc.h>

#include "ota_service.h"

LOG_MODULE_REGISTER(uart_comm, LOG_LEVEL_INF);

#define UART_NODE DT_NODELABEL(uart0)
#define BUF_SIZE 256

static const struct device *uart_dev = DEVICE_DT_GET(UART_NODE);
static uint8_t rx_buf[BUF_SIZE];
static size_t rx_len = 0;
static volatile bool uart_tx_busy = false;

// Latest valid sensor data received
static sensor_data_t latest_sensor_data = {
    .temperature = 0.0f,
    .humidity = 0.0f,
    .valid = false,
};

// Return pointer to latest sensor data
const sensor_data_t *uart_comm_get_sensor_data(void) {
  return &latest_sensor_data;
}

// Return TX status flag
bool uart_comm_is_tx_busy(void) { return uart_tx_busy; }

// External handler for ACKs received over UART
extern void ota_service_handle_ack(uint8_t *payload, uint8_t length);

// Send command packet over UART
int uart_comm_send_cmd(uint8_t pkt_type, uint8_t cmd, const uint8_t *payload,
                       uint8_t length) {
  uint8_t buf[3 + 1 + UART_MAX_PAYLOAD_SIZE]; // preamble + type + length + cmd
                                              // + payload + crc
  size_t total_payload_len = length;
  size_t total_len;

  buf[0] = PREAMBLE;
  buf[1] = pkt_type;

  if (pkt_type == UART_PKT_CMD || pkt_type == UART_PKT_ACK) {
    total_payload_len += 1;
    buf[2] = total_payload_len;
    buf[3] = cmd;
    if (payload && length > 0) {
      memcpy(&buf[4], payload, length);
    }
    total_len = 3 + total_payload_len + 1;
  } else {
    buf[2] = length;
    if (payload && length > 0) {
      memcpy(&buf[3], payload, length);
    }
    total_len = 3 + length + 1;
  }

  uint8_t crc = crc8_ccitt(0xFF, buf, total_len - 1);
  buf[total_len - 1] = crc;

  for (size_t i = 0; i < total_len; i++) {
    uart_poll_out(uart_dev, buf[i]);
  }

  LOG_INF("UART TX sent (%d bytes)", total_len);
  return 0;
}

// Debug utility (currently disabled)
static void print_hex_buffer(const uint8_t *buf, size_t len) {
  char hex_str[3 * BUF_SIZE] = {0};
  char *p = hex_str;

  for (size_t i = 0; i < len; i++) {
    p += snprintf(p, sizeof(hex_str) - (p - hex_str), "%02X ", buf[i]);
  }

  // Disabled to save memory
  // printk("UART RX (%d bytes): %s\n", (int)len, hex_str);
}

// OTA subcommands
static void ota_service_start(void) {
  LOG_INF("OTA INIT received");
  ota_active = true;
  ota_phase = OTA_PHASE_IDLE;
}

static void ota_service_receive_chunk(const uint8_t *data, uint8_t len) {
  if (!ota_active || ota_phase != OTA_PHASE_SENDING_DATA) {
    LOG_WRN("OTA chunk out of phase");
    return;
  }

  LOG_INF("OTA chunk received (%d bytes)", len);
  ota_queue_push(data, len);
}

static void ota_service_finalize(void) {
  if (!ota_active) {
    LOG_WRN("OTA END received without active session");
    return;
  }

  LOG_INF("OTA END received. Waiting for CRC32...");
  ota_phase = OTA_PHASE_WAIT_ACK_END;
}

// Parse and dispatch incoming UART packet
static void handle_packet_raw(const uint8_t *data, size_t len) {
  if (len < 4) {
    LOG_WRN("Packet too short");
    return;
  }

  if (data[0] != PREAMBLE) {
    LOG_WRN("Invalid preamble: 0x%02X", data[0]);
    return;
  }

  uint8_t type = data[1];
  uint8_t length = data[2];

  if ((3 + length + 1) > len) {
    LOG_WRN("Unexpected packet length: expected %d, got %d", 3 + length + 1,
            (int)len);
    return;
  }

  const uint8_t *payload = &data[3];
  uint8_t recv_crc = data[3 + length];
  uint8_t calc_crc = crc8_ccitt(0xFF, data, 3 + length);

  if (calc_crc != recv_crc) {
    LOG_WRN("CRC mismatch (calc=0x%02X, recv=0x%02X)", calc_crc, recv_crc);
    return;
  }

  LOG_INF("Valid packet received: type=0x%02X, len=%d", type, length);

  switch (type) {
  case UART_PKT_SENSOR:
    if (ota_is_active()) {
      LOG_DBG("Ignoring SENSOR packet during OTA");
      return;
    }

    if (length == 4) {
      int16_t temp_raw = (payload[0] << 8) | payload[1];
      int16_t hum_raw = (payload[2] << 8) | payload[3];

      latest_sensor_data.temperature = temp_raw / 100.0f;
      latest_sensor_data.humidity = hum_raw / 100.0f;
      latest_sensor_data.valid = true;

      LOG_INF("Sensor: Temp=%.2f C, Hum=%.2f %%",
              (double)latest_sensor_data.temperature,
              (double)latest_sensor_data.humidity);
    } else {
      LOG_WRN("Unexpected SENSOR payload length: %d", length);
    }
    break;

  case UART_PKT_ACK:
    if (length >= 1) {
      ota_service_handle_ack((uint8_t *)payload, length);
    }
    break;

  case UART_PKT_CMD:
    if (length >= 1) {
      uint8_t cmd = payload[0];
      const uint8_t *subpayload = &payload[1];
      uint8_t sublen = length - 1;

      LOG_INF("CMD received: 0x%02X (%d bytes)", cmd, sublen);

      switch (cmd) {
      case OTA_CMD_INIT:
        ota_service_start();
        break;
      case OTA_CMD_DATA:
        ota_service_receive_chunk(subpayload, sublen);
        break;
      case OTA_CMD_END:
        ota_service_finalize();
        break;
      case OTA_CMD_REBOOT:
        LOG_WRN("OTA_CMD_REBOOT received (not implemented)");
        break;
      default:
        LOG_WRN("Unknown CMD: 0x%02X", cmd);
        break;
      }
    } else {
      LOG_WRN("CMD packet too short");
    }
    break;

  default:
    LOG_INF("Unknown UART packet type: 0x%02X", type);
    break;
  }
}

// UART interrupt callback
static void uart_cb(const struct device *dev, void *user_data) {
  uint8_t c;

  while (uart_irq_update(dev) && uart_irq_is_pending(dev)) {

    if (uart_irq_rx_ready(dev)) {
      int recv = uart_fifo_read(dev, &c, 1);
      if (recv > 0 && rx_len < BUF_SIZE) {
        rx_buf[rx_len++] = c;

        // Skip junk until valid preamble
        while (rx_len > 0 && rx_buf[0] != PREAMBLE) {
          memmove(rx_buf, rx_buf + 1, --rx_len);
        }

        // Wait for complete frame
        if (rx_len >= 4) {
          uint8_t length = rx_buf[2];
          size_t expected_len = 4 + length; // includes CRC

          if (rx_len >= expected_len) {
            print_hex_buffer(rx_buf, expected_len);
            handle_packet_raw(rx_buf, expected_len);
            memmove(rx_buf, rx_buf + expected_len, rx_len - expected_len);
            rx_len -= expected_len;
          }
        }
      }
    }

    if (uart_irq_tx_ready(dev)) {
      uart_tx_busy = false;
      uart_irq_tx_disable(dev);
      LOG_DBG("UART TX complete");
    }
  }
}

// UART driver initialization
int uart_comm_init(void) {
  if (!device_is_ready(uart_dev)) {
    LOG_ERR("UART device not ready");
    return -ENODEV;
  }

  uart_irq_callback_user_data_set(uart_dev, uart_cb, NULL);
  uart_irq_rx_enable(uart_dev);

  LOG_INF("UART initialized");
  return 0;
}

// Return UART device handle
const struct device *uart_comm_get_dev(void) { return uart_dev; }
```
